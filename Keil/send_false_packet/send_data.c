#include "reg24le1.h" //Defini��es de muitos endere�os de registradores.
#include "stdint.h" //inteiros uint8_t, int8_t, uint16_t....
#include "stdbool.h" //Booleanos
#include "API.h"
#include "nRF-SPIComands.h"


//Subendere�os usados no sistema
#define MY_SUB_ADDR 0x01
#define OTHER_SUB_ADDR 0x02
// pacote = [sub_endere�o_destinatario] QWH	QWL	QXH	QXL	QYH	QYL	QZH	QZL	AXH	AXL	AYH	AYL	AZH	AZL GXH	GXL	GYH	GYL	GZH	GZL	MXH	MXL	MYH	MYL	MZH	MZL
uint8_t pacote[27];
uint8_t pacotes[] = {
	19,7,255,140,0,27,194,229,0,0,0,0,255,254,3,216,255,123,31,33,0,102,0,131,0,175,
	19,5,255,134,0,24,194,228,0,0,0,0,255,254,3,214,255,121,31,41,0,101,0,132,0,175,
	19,3,255,127,0,22,194,228,0,0,0,0,255,254,3,213,255,118,31,44,0,101,0,132,0,175,
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	17,143,253,24,255,38,194,135,0,0,0,0,255,254,3,222,255,131,31,36,0,103,0,131,0,174
};
// pacote a receber= [sub_endere�o_destinatario] [parar ou iniciar leituras]
#define Sinal_iniciar 0x0A
#define Sinal_parar 0x0B


#define INTERRUPT_TMR0	1

//Defini��es dos bot�es e leds
#define	PIN32
#ifdef 	PIN32
//Pushbuttons
sbit S1  = P0^2;    // 1/0=no/press
sbit S2  = P1^4;    // 1/0=no/press
//LEDS
sbit LED1 = P0^3; // 1/0=light/dark
sbit LED2 = P0^6; // 1/0=light/dark
#endif

void delay_ms(unsigned int x);
void start_T0(void);
void stop_T0(void);
void enviar_pacote_leituras();
void realizar_leituras();

/**************************************************/
// Vari�veis do TMR0
unsigned char NBT0H  = 0x52;			// Este tempo
unsigned char NBT0L  = 0x63;			// equivale a
unsigned char NOVT0  = 0x00;			// Freq. de Amostragem de 30Hz
int timer_flag = 3;
/**************************************************/
void TMR0_IRQ(void) interrupt INTERRUPT_TMR0
{
	if(!NOVT0)
	{
		timer_flag--;
		if(timer_flag <= 0){
			timer_flag = 3;
            realizar_leituras();
            enviar_pacote_leituras();
		}
		TH0= NBT0H;
		TL0= NBT0L;
	}
}
/**************************************************/

void luzes_iniciais(void){
        LED1 = 1; LED2 = 0;
        delay(1000);
        LED1 = 0; LED2 = 1;
        delay(1000);
        LED1 = 1; LED2 = 1;
        delay(1000);
        LED1 = 0; LED2 = 0;
}

void setup(void){
	 // Set up GPIO
    P0DIR = 0xB7;   // 1011 0111 - 1/0 = In/Out - Output: P0.3 e P0.6
    P1DIR = 0xFF;   // Tudo input
    P2DIR = 0xFF;
    P0CON = 0x00;  	// All general I/O
    P1CON = 0x00;  	// All general I/O
    P2CON = 0x00;  	// All general I/O
	// Radio + SPI setup
    RFCE = 0;       // Radio chip enable low
    RFCKEN = 1;     // Radio clk enable
    RF = 1;

    rf_init();
    EA=1; //ativa as interrup��es
	luzes_iniciais();
    RX_Mode();
}
void main(void){
	setup();
	while(1){
		if(newPayload){
			//verifica se o sinal � para mim
			if(rx_buf[0]== MY_SUB_ADDR){
				 switch(rx_buf[1]){
					case Sinal_iniciar:
                        LED1 = 1;
                        start_T0();
						break;
					case Sinal_parar:
                        LED1 = 0;
                        stop_T0();
						break;
				}

			}
			sta = 0;
     		newPayload = 0;
		}
	}
}
/**************************************************/
void delay_ms(unsigned int x)
{
    unsigned int i,j;
    i=0;
    for(i=0;i<x;i++)
    {
       j=508;
           ;
       while(j--);
    }
}
/**************************************************/
/****************TIMER*****************************/
/**************************************************/
//Timer comfigurado para freq de amostragem 30Hz
void start_T0(void)
{
	TMOD=0x31;						// Select Timer 1 --> STOPPED, Timer 0 --> TIMER/16 bits
	TH0= NBT0H;
	TL0= NBT0L;
	ET0=1;								// Active interrupt on Timer 0
	EA=1;									// Active all interrupts
	TR0=1;								// Timer 0 --> RUN
}
/**************************************************/
void stop_T0(void)
{
	TMOD=0x31;						// Select Timer 1 --> STOPPED, Timer 0 --> TIMER/16 bits
	TH0= NBT0H;
	TL0= NBT0L;
	ET0=0;								// Active interrupt on Timer 0
	EA=1;									// Active all interrupts
	TR0=0;								// Timer 0 --> RUN
}
/********************PACOTE******************/
void enviar_pacote_leituras(){
	LED2 = 1;
	for(int i = 1; i<27; i++){
		tx_buf[i] = pacote[i];
	}
	TX_Mode_NOACK(27);
	RX_Mode();
	LED2 = 0;
}
int index_pacote = 0;
void realizar_leituras(){
	pacote[0] = MY_SUB_ADDR; //o pacote sempre começa com o endereço
	for(int i = 0; i<26; i++){ //é preenchido com as 26 leituras
		pacote[i+1] = pacotes[index_pacote+i];
	}
	index_pacote = index_pacote+26;//passa para a proxima linha de pacotes de exemplo
	//TODO: calcular melhor esse numero maximo
	if(index_pacote >= 2000){ //se ta chegando no final recomeça
		index_pacote=0;
	}
}
